


		.EQU		LCDPORT			= PORTA		; SET SIGNAL PORT REG TO PORTA
`		.EQU		LCDPORTDIR		= DDRA		; SET SIGNAL PORT DIR REG TO PORTA
		.EQU		LCDPORTPIN		= PINA		; SET CLEAR SIGNAL PORT PIN REG TO PORTA
		.EQU		LCD_RS			= PINA0
		.EQU		LCD_RW			= PINA1
		.EQU		LCD_EN			= PINA2
		.EQU		LCD_D7			= PINA7
		.EQU		LCD_D6			= PINA6
		.EQU		LCD_D5			= PINA5
		.EQU		LCD_D4			= PINA4
		.EQU		NULL			= $00		;ASCII END
				
		.EQU		INPUT_DDR		= DDRD	
		.EQU		INPUT_PORT		= PORTD	
		.EQU		INPUT_PIN		= PIND	

		.EQU		OUTPUT_DDR		= DDRB	
		.EQU		OUTPUT_PORT		= PORTB	
		
		.ORG		0X00
		RJMP		START
		.ORG		0X40




START:	RCALL		LCD_Init	
		
		LDI			R16,			0X0F
		OUT			INPUT_DDR,		R16
		LDI			R16,			0XFF
		OUT			INPUT_PORT,		R16
		
		LDI			R16,			0XFF
		OUT			OUTPUT_DDR,			R16
		LDI			R16,			0X00
		OUT			OUTPUT_PORT,			R16


MAIN:
		RCALL		KEY_RD
		RCALL		HEX_ASC
		OUT			OUTPUT_PORT,			R18

		MOV			R16,			R18
		RCALL		LCD_SEND_DATA

		LDI			R16,			$80
		RCALL		LCD_SEND_COMMAND

		RJMP		MAIN



;__________________________________________________________________
; SUBROUTINE TO SEND COMMAND TO LCD
;COMMAND CODE IN R16
;LCD_D7..LCD_D4 CONNECT TO PA7..PA4
;LCD_RS CONNECT TO PA0
;LCD_RW CONNECT TO PA1-
;LCD_EN CONNECT TO PA2
LCD_SEND_COMMAND:
		PUSH		R17
		CALL		LCD_WAIT_BUSY	; CHECK IF LCD IS BUSY 
		MOV			R17,			R16		;SAVE THE COMMAND				
		 ; SET RS LOW TO SELECT COMMAND REGISTER
		; SET RW LOW TO WRITE TO LCD
		ANDI		R17,			0XF0
    ; SEND COMMAND TO LCD
		OUT			LCDPORT,		R17  
		NOP
		NOP
    ; PULSE ENABLE PIN
		SBI			LCDPORT,		LCD_EN
		NOP
		NOP
		CBI			LCDPORT,		LCD_EN
		SWAP		R16
		ANDI		R16,			0XF0
    ; SEND COMMAND TO LCD
		OUT			LCDPORT,		R16   
    ; PULSE ENABLE PIN
		SBI			LCDPORT,		LCD_EN
		NOP
		NOP
		CBI			LCDPORT,		LCD_EN
		POP			R17
		RET
;_________________________________________________________________
LCD_SEND_DATA:
		PUSH		R17
		CALL		LCD_WAIT_BUSY	;CHECK IF LCD IS BUSY
		MOV			R17,			R16		;SAVE THE COMMAND				
    ; SET RS HIGH TO SELECT DATA REGISTER
    ; SET RW LOW TO WRITE TO LCD
		ANDI		R17,			0XF0
		ORI			R17,			0X01
    ; SEND DATA TO LCD
		OUT			LCDPORT,		R17   
		NOP
    ; PULSE ENABLE PIN
		SBI			LCDPORT,		LCD_EN
		NOP
		CBI			LCDPORT,		LCD_EN
    ; DELAY FOR COMMAND EXECUTION
	;SEND THE LOWER NIBBLE
		NOP
		SWAP		R16
		ANDI		R16,			0XF0
	; SET RS HIGH TO SELECT DATA REGISTER
    ; SET RW LOW TO WRITE TO LCD
		ANDI		R16,			0XF0
		ORI			R16,			0X01
    ; SEND COMMAND TO LCD
		OUT			LCDPORT,		R16
		NOP
    ; PULSE ENABLE PIN
		SBI			LCDPORT,		LCD_EN
		NOP
		CBI			LCDPORT,		LCD_EN
		POP			R17
		RET
;_______________________________________________________
LCD_WAIT_BUSY:
		PUSH		R16
		LDI			R16,			0B00000111  ; SET PA7-PA4 AS INPUT, PA2-PA0 AS OUTPUT
		OUT			LCDPORTDIR,		R16
		LDI			R16,			0B11110010	; SET RS=0, RW=1 FOR READ THE BUSY FLAG
		OUT			LCDPORT,		R16
		NOP
LCD_WAIT_BUSY_LOOP:
		SBI			LCDPORT,		LCD_EN
		NOP
		NOP
		IN			R16,			LCDPORTPIN
		CBI			LCDPORT,		LCD_EN
		NOP
		SBI			LCDPORT,		LCD_EN
		NOP
		NOP
		CBI			LCDPORT,		LCD_EN
		NOP
		ANDI		R16,			0X80
		CPI			R16,			0X80
		BREQ		LCD_WAIT_BUSY_LOOP
		LDI			R16,			0B11110111  ; SET PA7-PA4 AS OUTPUT, PA2-PA0 AS OUTPUT
		OUT			LCDPORTDIR,		R16
		LDI			R16,			0B00000000	; SET RS=0, RW=1 FOR READ THE BUSY FLAG
		OUT			LCDPORT,		R16	
		POP			R16
		RET

	;INIT THE LCD
;LCD_D7..LCD_D4 CONNECT TO PA7..PA4
;LCD_RS CONNECT TO PA0
;LCD_RW CONNECT TO PA1
;LCD_EN CONNECT TO PA2

LCD_INIT:
    ; SET UP DATA DIRECTION REGISTER FOR PORT A
		LDI			R16,			0B11110111  ; SET PA7-PA4 AS OUTPUTS, PA2-PA0 AS OUTPUT
		OUT			LCDPORTDIR,		R16
    ; WAIT FOR LCD TO POWER UP
		CALL		DELAY_10MS
		CALL		DELAY_10MS
    
    ; SEND INITIALIZATION SEQUENCE
		LDI			R16,			0X02    ; FUNCTION SET: 4-BIT INTERFACE
		CALL		LCD_SEND_COMMAND
		LDI			R16,			0X28    ; FUNCTION SET: ENABLE 5X7 MODE FOR CHARS 
		CALL		LCD_SEND_COMMAND
		LDI			R16,			0X0C    ; DISPLAY CONTROL: DISPLAY OFF, CURSOR ON
		CALL		LCD_SEND_COMMAND
		LDI			R16,			0X01    ; CLEAR DISPLAY
		CALL		LCD_SEND_COMMAND
		LDI			R16, 0X80    ; CLEAR DISPLAY
		CALL		LCD_SEND_COMMAND
		RET

;___________________________________________________________
DELAY_10MS:
		
		LDI			R17,			80
L2:	
		LDI			R18,			250	
L1:
		NOP
		DEC			R18
		BRNE		L1
	
		DEC			R17
		BRNE		L2

		RET
;__________________________________________________
;------------------------------------------
;HEX_ASC CHUY?N T? MÃ HEX SANG MÃ ASCII
;INPUT R17=MÃ HEX,OUTPUT R18=MÃ ASCII
;------------------------------------------
HEX_ASC:
		CPI			R17,			0X0A ;KÝ T? <$0A?
		BRCS		NUM						;C=1 NH? H?N
		LDI			R18,			0X37 ;KÝ T? CH?
		RJMP		CHAR
NUM: 
		LDI			R18,			0X30 ;KÝ T? S?
CHAR: 
		ADD			R18,			R17 ;C?NG THÊM $30
		RET	
;------------------------------------------
;KEY_RD ??C TR?NG THÁI PHÍM
;CH?NG RUNG PHÍM KHI NH?N/NH? 50 L?N
;S? D?NG GET_KEY16 NH?N D?NG PHÍM NH?N
;CH? THOÁT KHI CÓ PHÍM NH?N!!!
;-------------------------------------------
KEY_RD: 
		LDI			R16,			50 ;S? L?N NH?N D?NG PHÍM NH?N
BACK1: 
		RCALL		GET_KEY16				;G?I CTC NH?N D?NG PHÍM
		BRCC		KEY_RD					;C=0 PHÍM CH?A NH?N L?P L?I
		DEC			R16					;??M S? L?N NH?N D?NG PHÍM
		BRNE		BACK1					;L?P VÒNG CHO ?? S? L?N ??M
		PUSH		R17						;XÁC NH?N PHÍM NH?N,C?T MÃ PHÍM
WAIT_1: 
		LDI			R16,			50 ;S? L?N NH?N D?NG PHÍM NH?
BACK2: 
		RCALL		GET_KEY16			;G?I CTC NH?N D?NG PHÍM
		BRCS		WAIT_1					;C=1 PHÍM CH?A NH?
		DEC			R16						;??M S? L?N NH?N D?NG PHÍM
		BRNE		BACK2				;L?P VÒNG CHO ?? S? L?N ??M
		POP			R17					;XÁC NH?N PHÍM NH? L?Y L?I MÃ PHÍM
		RET
;-----------------------------------------
;GET_KEY16 ??C TR?NG THÁI CÁC PHÍM,
;TR? V? R17= MÃ PHÍM VÀ C=1 N?U CÓ PHÍM NH?N
;TR? V? C=0 N?U PHÍM CH?A NH?N
;------------------------------------------
GET_KEY16:
		LDI			R17,			4 ;R17 ??M S? L?N QUÉT C?T
		LDI			R20,			0XFE ;B?T ??U QUÉT C?T 0
SCAN_COL:
		OUT			INPUT_PORT,		R20 ;
		IN			R19,			INPUT_PIN ;??C TR?NG THÁI HÀNG
		IN			R19,			INPUT_PIN ;??C L?I TR?NG THÁI HÀNG
		ANDI		R19,			0XF0 ;CHE 4 BIT CAO L?Y MÃ HÀNG
		CPI			R19,			0XF0 ;XEM CÓ PHÍM NH?N?
		BRNE		CHK_KEY ;R19 KHÁC F0H, CÓ PHÍM NH?N
		LSL			R20 ;QUÉT C?T K? TI?P
		INC			R20 ;??T LSB=1
		DEC			R17 ;GI?M S? L?N QUÉT C?T
		BRNE		SCAN_COL ;TI?P T?C QUÉT H?T S? C?T
		CLC					;PHÍM CH?A NH?N, C=0
		RJMP		EXIT ;THOÁT
CHK_KEY:
		SUBI		R17,		4 ;TÍNH V? TRÍ C?T
		NEG			R17 ;BÙ 2 L?Y S? D??NG
		SWAP		R19 ;??O SANG 4 BIT TH?P MÃ HÀNG
		LDI			R20,		4 ;R20 ??M S? L?N QUÉT HÀNG
SCAN_ROW:
		ROR			R19 ;QUAY PH?I QUA C TÌM BIT 0
		BRCC		SET_FLG ;C=0 V? TRÍ HÀNG CÓ PHÍM NH?N
		INC			R17 ;KHÔNG ?ÚNG HÀNG 
						;T?NG V? TRÍ HÀNG THÊM 4
		INC			R17
		INC			R17
		INC			R17
		DEC			R20
		BRNE		SCAN_ROW ;QUÉT H?T 4 HÀNG
		CLC ;KHÔNG CÓ PHÍM NH?N C=0
		RJMP		EXIT ;THOÁT
SET_FLG:
		SEC ;CÓ PHÍM NH?N C=1
EXIT: 
		RET
