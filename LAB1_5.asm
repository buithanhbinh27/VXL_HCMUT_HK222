;
; LAB1_5.asm
;
; Created: 20/03/2023 10:36:44 SA
; Author : Admin
;


; Replace with your application code

.EQU	OUTPUT_DDR	=	DDRA
.EQU	OUTPUT_PORT	=	PORTA
.EQU	OUTPUT_PIN	=	PINA

.EQU	INPUT_DDR	=	DDRB
.EQU	INPUT_PORT	=	PORTB
.EQU	INPUT_PIN	=	PINB


LDI		R16,			0X00
OUT		INPUT_DDR,		R16
LDI		R16,			0XFF
OUT		INPUT_PORT,		R16

LDI		R16,			0XFF
OUT		OUTPUT_DDR,		R16
		
LOOP: 
SBIC	INPUT_PIN,	0
RJMP	TURN_OFF
RJMP	TURN_ON


TURN_ON:
RCALL	CHECK_BUTTON_ON
SBI		OUTPUT_PORT,	0
RJMP	LOOP

CHECK_BUTTON_ON:
CHECK_ON:
LDI		R16,	50
LOOP_ON:
SBIC	INPUT_PIN,	0
RJMP	CHECK_ON
DEC		R16
BRNE	LOOP_ON
RET


TURN_OFF:
RCALL	CHECK_BUTTON_OFF
CBI		OUTPUT_PORT,	0
RJMP	LOOP

CHECK_BUTTON_OFF:
CHECK_OFF:
LDI		R16,	50
LOOP_OFF:
SBIS	INPUT_PIN,	0
RJMP	CHECK_OFF
DEC		R16
BRNE	LOOP_OFF
RET
