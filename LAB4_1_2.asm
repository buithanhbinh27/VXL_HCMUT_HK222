;
; LAB4_1_1.asm
; 100hZ -> N = 8 -> 1 CK = 8000 MC 
.EQU	P_OUT	=0
.EQU	TF		= 8000 ;TF=giá tr? ??t tr??c

.ORG	0
RJMP	MAIN

.ORG	0X20
RJMP	OVERFLOW

.ORG	0X40
MAIN: 

LDI		R16,	HIGH(RAMEND)
OUT		SPH,	R16
LDI		R16,	LOW(RAMEND)
OUT		SPL,	R16

SEI	

LDI		R16,	HIGH(TF)
STS		OCR1AH,	R16
LDI		R16,	LOW(TF)
STS		OCR1AL,	R16

LDI		R16,	(1<<P_OUT) ;??t P_OUT output
OUT		DDRC,	R16


LDI		R16,	(1<<OCIE1A)
STS		TIMSK1,	R16

LDI		R17,	0X00 ;Timer1 mode CTC
STS		TCCR1A,	R17

LDI		R17,	(1<<WGM12)|(1<<CS10) ;Timer1 mode ctc, n = 1
STS		TCCR1B,	R17

SBI		PORTC,	0

LDI		R20,	0

START: 
RJMP	START


OVERFLOW:

INC		R20
CPI		R20,	$05
BRNE	END

CLR		R20

IN		R16,	PORTC
COM		R16
ANDI	R16,	1
OUT		PORTC,	R16	

END:
RETI

