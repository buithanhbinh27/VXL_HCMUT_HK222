;
; VD6-17_4BIT.ASM
;
; CREATED: 12/13/2022 9:14:58 AM
		.EQU		LCDPORT			= PORTA		; SET SIGNAL PORT REG TO PORTA
`		.EQU		LCDPORTDIR		= DDRA		; SET SIGNAL PORT DIR REG TO PORTA
		.EQU		LCDPORTPIN		= PINA		; SET CLEAR SIGNAL PORT PIN REG TO PORTA
		.EQU		LCD_RS			= PINA0
		.EQU		LCD_RW			= PINA1
		.EQU		LCD_EN			= PINA2
		.EQU		LCD_D7			= PINA7
		.EQU		LCD_D6			= PINA6
		.EQU		LCD_D5			= PINA5
		.EQU		LCD_D4			= PINA4
		.EQU		NULL			= $00		;ASCII END				
		.ORG		0X00
		RJMP		START
		.ORG		0X40

START:
;---------------------------------------------------------
		RCALL		LCD_INIT
MAIN:
		LDI			R16,			$80
		RCALL		LCD_SEND_COMMAND

		LDI			ZH,				HIGH(LI1<<1)	
		LDI			ZL,				LOW(LI1<<1)
LINE1:	LPM			R16,			Z+					
		CPI			R16,			NULL					
		BREQ		TT									
		RCALL		LCD_SEND_DATA			
		RJMP		LINE1					

TT:		LDI			R16,			$C0
		RCALL		LCD_SEND_COMMAND

		LDI			ZH,				HIGH(LI2<<1)	
		LDI			ZL,				LOW(LI2<<1)
LINE2:	
		LPM			R16,			Z+					
		CPI			R16,			NULL					
		BREQ		KETTHUC					
		RCALL		LCD_SEND_DATA			
		RJMP		LINE2					
KETTHUC:
		RJMP		MAIN

;__________________________________________________________________
; SUBROUTINE TO SEND COMMAND TO LCD
;COMMAND CODE IN R16
;LCD_D7..LCD_D4 CONNECT TO PA7..PA4
;LCD_RS CONNECT TO PA0
;LCD_RW CONNECT TO PA1-
;LCD_EN CONNECT TO PA2
LCD_SEND_COMMAND:
		PUSH		R17
		CALL		LCD_WAIT_BUSY	; CHECK IF LCD IS BUSY 
		MOV			R17,			R16		;SAVE THE COMMAND				
		 ; SET RS LOW TO SELECT COMMAND REGISTER
		; SET RW LOW TO WRITE TO LCD
		ANDI		R17,			0XF0
    ; SEND COMMAND TO LCD
		OUT			LCDPORT,		R17  
		NOP
		NOP
    ; PULSE ENABLE PIN
		SBI			LCDPORT,		LCD_EN
		NOP
		NOP
		CBI			LCDPORT,		LCD_EN
		SWAP		R16
		ANDI		R16,			0XF0
    ; SEND COMMAND TO LCD
		OUT			LCDPORT,		R16   
    ; PULSE ENABLE PIN
		SBI			LCDPORT,		LCD_EN
		NOP
		NOP
		CBI			LCDPORT,		LCD_EN
		POP			R17
		RET
;_________________________________________________________________
LCD_SEND_DATA:
		PUSH		R17
		CALL		LCD_WAIT_BUSY	;CHECK IF LCD IS BUSY
		MOV			R17,			R16		;SAVE THE COMMAND				
    ; SET RS HIGH TO SELECT DATA REGISTER
    ; SET RW LOW TO WRITE TO LCD
		ANDI		R17,			0XF0
		ORI			R17,			0X01
    ; SEND DATA TO LCD
		OUT			LCDPORT,		R17   
		NOP
    ; PULSE ENABLE PIN
		SBI			LCDPORT,		LCD_EN
		NOP
		CBI			LCDPORT,		LCD_EN
    ; DELAY FOR COMMAND EXECUTION
	;SEND THE LOWER NIBBLE
		NOP
		SWAP		R16
		ANDI		R16,			0XF0
	; SET RS HIGH TO SELECT DATA REGISTER
    ; SET RW LOW TO WRITE TO LCD
		ANDI		R16,			0XF0
		ORI			R16,			0X01
    ; SEND COMMAND TO LCD
		OUT			LCDPORT,		R16
		NOP
    ; PULSE ENABLE PIN
		SBI			LCDPORT,		LCD_EN
		NOP
		CBI			LCDPORT,		LCD_EN
		POP			R17
		RET
;_______________________________________________________
LCD_WAIT_BUSY:
		PUSH		R16
		LDI			R16,			0B00000111  ; SET PA7-PA4 AS INPUT, PA2-PA0 AS OUTPUT
		OUT			LCDPORTDIR,		R16
		LDI			R16,			0B11110010	; SET RS=0, RW=1 FOR READ THE BUSY FLAG
		OUT			LCDPORT,		R16
		NOP
LCD_WAIT_BUSY_LOOP:
		SBI			LCDPORT,		LCD_EN
		NOP
		NOP
		IN			R16,			LCDPORTPIN
		CBI			LCDPORT,		LCD_EN
		NOP
		SBI			LCDPORT,		LCD_EN
		NOP
		NOP
		CBI			LCDPORT,		LCD_EN
		NOP
		ANDI		R16,			0X80
		CPI			R16,			0X80
		BREQ		LCD_WAIT_BUSY_LOOP
		LDI			R16,			0B11110111  ; SET PA7-PA4 AS OUTPUT, PA2-PA0 AS OUTPUT
		OUT			LCDPORTDIR,		R16
		LDI			R16,			0B00000000	; SET RS=0, RW=1 FOR READ THE BUSY FLAG
		OUT			LCDPORT,		R16	
		POP			R16
		RET

	;INIT THE LCD
;LCD_D7..LCD_D4 CONNECT TO PA7..PA4
;LCD_RS CONNECT TO PA0
;LCD_RW CONNECT TO PA1
;LCD_EN CONNECT TO PA2

LCD_INIT:
    ; SET UP DATA DIRECTION REGISTER FOR PORT A
		LDI			R16,			0B11110111  ; SET PA7-PA4 AS OUTPUTS, PA2-PA0 AS OUTPUT
		OUT			LCDPORTDIR,		R16
    ; WAIT FOR LCD TO POWER UP
		CALL		DELAY_10MS
		CALL		DELAY_10MS
    
    ; SEND INITIALIZATION SEQUENCE
		LDI			R16,			0X02    ; FUNCTION SET: 4-BIT INTERFACE
		CALL		LCD_SEND_COMMAND
		LDI			R16,			0X28    ; FUNCTION SET: ENABLE 5X7 MODE FOR CHARS 
		CALL		LCD_SEND_COMMAND
		LDI			R16,			0X0C    ; DISPLAY CONTROL: DISPLAY OFF, CURSOR ON
		CALL		LCD_SEND_COMMAND
		LDI			R16,			0X01    ; CLEAR DISPLAY
		CALL		LCD_SEND_COMMAND
		LDI			R16, 0X80    ; CLEAR DISPLAY
		CALL		LCD_SEND_COMMAND
		RET

;___________________________________________________________
DELAY_10MS:
		
		LDI			R17,			80
L2:	
		LDI			R18,			250	
L1:
		NOP
		DEC			R18
		BRNE		L1
	
		DEC			R17
		BRNE		L2

		RET
;_____________________________________________
LI1: .DB "TN VXL-P01",$00


LI2: .DB "BINH-2010925",$00

