;
; LAB4_1_1.asm
; 100hZ -> N = 8 -> 1 CK = 8000 MC 
.EQU	P_OUT	=0
.EQU	TF		= 4000 ;TF=giá tr? ??t tr??c
.EQU		DATA_0			=	7
.EQU		DATA_1			=	11
.EQU		DATA_2			=	13
.EQU		DATA_3			=	14

.EQU		LED_0			=	$C0
.EQU		LED_1			=	$F9
.EQU		LED_2			=	$A4
.EQU		LED_3			=	$B0

.EQU		OUTPUT_LED		=	PORTA
.EQU		OUTPUT_CONTROL	=	PORTB

.ORG		0
RJMP		MAIN

.ORG		0X1A
RJMP		OVERFLOW

.ORG		0X40
MAIN: 

LDI			R16,			HIGH(RAMEND)
OUT			SPH,			R16
LDI			R16,			LOW(RAMEND)
OUT			SPL,			R16

SEI	

LDI			R16,			LOW(TF)
STS			OCR1AL,			R16
LDI			R16,			HIGH(TF)
STS			OCR1AH,			R16

LDI			R16,			0XFF
OUT			DDRA,			R16
OUT			DDRB,			R16

LDI			R17,			0X00 ;Timer1 mode CTC
STS			TCCR1A,			R17

LDI			R17,			(1<<WGM12)|(1<<CS10) ;Timer1 mode ctc, n = 1
STS			TCCR1B,			R17

LDI			R16,			(1<<OCIE1A)
STS			TIMSK1,			R16

LDI			R20,			0

START: 
RJMP		START


OVERFLOW:

INC			R20

CPI			R20,			1
BREQ		XUAT1

CPI			R20,			2
BREQ		XUAT2

CPI			R20,			3
BREQ		XUAT3

CPI			R20,			4
BREQ		XUAT4

CPI			R20,			5
BREQ		RST


XUAT1:	
LDI			R22,			LED_0
LDI			R24,			DATA_0
RCALL		OUT_LED
RETI

XUAT2:
LDI			R22,			LED_1
LDI			R24,			DATA_1
RCALL		OUT_LED
RETI

XUAT3:
LDI			R22,			LED_2
LDI			R24,			DATA_2
RCALL		OUT_LED
RETI

XUAT4:
LDI			R22,			LED_3
LDI			R24,			DATA_3
RCALL		OUT_LED
RETI

RST:	
CLR			R20
RETI
;_______________________
OUT_LED:		
LDI			R17,			0X01 ;NLED0 = 0 NLED 1 = 1
OUT			OUTPUT_CONTROL,	R17		
									;DATA
OUT			OUTPUT_LED,		R22
		
LDI			R17,			0X00 ;NLED0 = 0 NLED1 = 0
OUT			OUTPUT_CONTROL,	R17

LDI			R17,			0X02;NLED0 = 0 NLED 1 = 1
OUT			OUTPUT_CONTROL,	R17	
			
OUT			OUTPUT_LED,		R24	;DATA CHON DEN

LDI			R17,			0X00 ;NLED0 = 0 NLED1 = 1
OUT			OUTPUT_CONTROL,	R17
RET
;R17 = THANH GHI RAC
;R22 = DATA
;R24 = DATA CHON DEN
